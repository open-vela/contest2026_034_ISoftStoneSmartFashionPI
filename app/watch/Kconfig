## app/watch/Kconfig
```kconfig
config EXAMPLES_CONTEST2026_WATCH_BOOT
        bool "Contest 2026 - Boot Logo & Animation"
        depends on GRAPHICS_LVGL
        default n
        ---help---
                Enable boot logo display and boot animation playback
                for the ESP32-S3 Touch AMOLED platform.
                
                Features:
                - iSoftStone logo display at power-on (1 second)
                - Power-on animation (42 frames at 10fps, ~4.2 seconds)
                - Uses embedded C array image resources (no filesystem)

config EXAMPLES_CONTEST2026_WATCH_DEBUG
        bool "Contest 2026 - Watch debug logs"
        depends on EXAMPLES_CONTEST2026_WATCH_BOOT
        default n
        ---help---
                Enable debug printf output (WATCH_DBG_LOG) from the watch
                app and related board code.  Keep disabled in production:
                console output blocks when no USB serial host is attached.
```

## app_watch/Kconfig
```kconfig
config LVX_USE_ESP32S3_WATCH
        bool "Smart esp32s3 watch"
        depends on GRAPHICS_LVGL && LV_USE_FRAGMENT
        default n
        ---help---
                Enable build esp32s3 watch programs

if LVX_USE_ESP32S3_WATCH

config WATCH_BASE_PATH
        string "Base path in watch"
        default "/mnt/sd"

config LVX_USE_ESP32S3_WATCH_PRIORITY
        int "watch task priority"
        default 100

config LVX_USE_ESP32S3_WATCH_STACKSIZE
        int "watch stack size"
        default 32768

config LVX_USE_ESP32S3_WATCH_INPUT_DEVPATH
        string "Touchscreen device path"
        default "/dev/input0"
        depends on INPUT_TOUCHSCREEN
        ---help---
                The path to the touchscreen device. Default: "/dev/input0"

endif # LVX_USE_ESP32S3_WATCH
```

## board/esp32s3-touch-amoled/Kconfig
```kconfig
#
# For a description of the syntax of this configuration file,
# see the file kconfig-language.txt in the NuttX tools repository.
#

if ARCH_BOARD_ESP32S3_TOUCH_AMOLED

config ESP32S3_WATCH_AMOLED_CO5300
	bool "Enable ESP32-S3 AMOLED"
	default n
	select LCD
	select LCD_CO5300
	---help---
		Enable board AMOLED support, IC is AMOLED_CO5300.


config ESP32S3_WATCH_TOUCHSCREEN_FT3168
    bool "Enable Board Touchscreen"
    default n
    select INPUT
    select INPUT_TOUCHSCREEN
    select SCHED_WORKQUEUE
    select SCHED_LPWORK
    ---help---
        Enable board touchscreen support, IC is: FT3168

menu "Board Touchscreen Configuration"
	depends on ESP32S3_WATCH_TOUCHSCREEN_FT3168

config ESP32S3_BOARD_TOUCHSCREEN_PATH
	string "Touchscreen Path for VFS"
	default "/dev/input0"

config ESP32S3_BOARD_TOUCHSCREEN_WIDTH
	int "Touchscreen Width"
	default 410
	depends on ESP32S3_WATCH_TOUCHSCREEN_FT3168

config ESP32S3_BOARD_TOUCHSCREEN_HEIGHT
	int "Touchscreen Height"
	default 502
	depends on ESP32S3_WATCH_TOUCHSCREEN_FT3168

config ESP32S3_BOARD_TOUCHSCREEN_SAMPLE_CACHES
	int "Touchscreen Sample Cache Number"
	default 64

config ESP32S3_BOARD_TOUCHSCREEN_SAMPLE_DELAYS
	int "Touchscreen Sample Delay Ticks"
	default 20

config ESP32S3_BOARD_TOUCHSCREEN_X_MIRROR
	bool "Touchscreen X Mirror"
	default y
	depends on ESP32S3_WATCH_TOUCHSCREEN_FT3168

config ESP32S3_BOARD_TOUCHSCREEN_Y_MIRROR
	bool "Touchscreen Y Mirror"
	default n
	depends on ESP32S3_WATCH_TOUCHSCREEN_FT3168

endmenu # Touchscreen Configuration

endif # ARCH_BOARD_ESP32S3_TOUCH_AMOLED
```

## examples/esp32s3_watch_pcf85063/Kconfig
```kconfig
#
# For a description of the syntax of this configuration file,
# see the file kconfig-language.txt in the NuttX tools repository.
#

config EXAMPLES_ESP32S3_WATCH_PCF85063
	tristate "ESP32-S3 PCF85063 RTC Test Example"
	default n
	depends on RTC_DRIVER && RTC_PCF85063
	---help---
		Enable the ESP32-S3 PCF85063 RTC Test example. This example tests
		the PCF85063 RTC functionality including time read, time set,
		alarm functionality, and continuous time reading.

if EXAMPLES_ESP32S3_WATCH_PCF85063

config EXAMPLES_ESP32S3_WATCH_PCF85063_PROGNAME
	string "Program name"
	default "esp32s3pcf85063"
	---help---
		This is the name of the program that will be used when the NSH ELF
		program is installed.

config EXAMPLES_ESP32S3_WATCH_PCF85063_PRIORITY
	int "PCF85063 test task priority"
	default 100

config EXAMPLES_ESP32S3_WATCH_PCF85063_STACKSIZE
	int "PCF85063 test stack size"
	default DEFAULT_TASK_STACKSIZE

endif
```

## examples/mimo_stream_voice_test/Kconfig
```kconfig
#
# For a description of the syntax of this configuration file,
# see the file kconfig-language.txt in the NuttX tools repository.
#

config EXAMPLES_MIMO_STREAM_VOICE_TEST
	tristate "MiMo streaming voice test (ASR+TTS via SSE)"
	default n
	depends on AI_AGENT_MIMO_VOICE && SYSTEM_NXRECORDER && SYSTEM_NXPLAYER
	---help---
		End-to-end streaming voice pipeline test using MiMo ASR and TTS
		with Server-Sent Events (SSE) for incremental response parsing.
		Records audio, sends to MiMo ASR with streaming enabled, then
		feeds recognized text to MiMo TTS with streaming, and plays the
		result back through the speaker.

if EXAMPLES_MIMO_STREAM_VOICE_TEST

config EXAMPLES_MIMO_STREAM_VOICE_TEST_PROGNAME
	string "Program name"
	default "mimo_stream_test"

config EXAMPLES_MIMO_STREAM_VOICE_TEST_PRIORITY
	int "Task priority"
	default 100

config EXAMPLES_MIMO_STREAM_VOICE_TEST_STACKSIZE
	int "Stack size"
	default 32768

endif # EXAMPLES_MIMO_STREAM_VOICE_TEST
```

## examples/mimo_voice_test/Kconfig
```kconfig
#
# For a description of the syntax of this configuration file,
# see the file kconfig-language.txt in the NuttX tools repository.
#
config EXAMPLES_MIMO_VOICE_TEST
	tristate "MiMo Voice (ASR/TTS) End-to-End Test"
	default n
	depends on SYSTEM_NXPLAYER && SYSTEM_NXRECORDER
	depends on EXAMPLES_AI_AGENT_VELA
	depends on AI_AGENT_MIMO_VOICE
	---help---
		End-to-end voice pipeline test using Xiaomi MiMo ASR/TTS.
		Flow: record WAV to SD card -> MiMo ASR -> MiMo TTS
		-> save synthesized WAV to SD card -> play back.
		Depends on nxrecorder / nxplayer for audio I/O and the
		ai_agent voice framework for MiMo backends.

if EXAMPLES_MIMO_VOICE_TEST

config EXAMPLES_MIMO_VOICE_TEST_PROGNAME
	string "Program name"
	default "mimo_voice_test"
	---help---
		This is the name of the NSH built-in command.

config EXAMPLES_MIMO_VOICE_TEST_PRIORITY
	int "MiMo voice test task priority"
	default 100

config EXAMPLES_MIMO_VOICE_TEST_STACKSIZE
	int "MiMo voice test stack size"
	default 16384

endif
```
